## arch/risc-v/src/hpmicro/hpm6750/Kconfig
```kconfig
#
# For a description of the syntax of this configuration file,
# see the file kconfig-language.txt in the NuttX tools repository.
#

menu "HPM6750 Peripheral Support"

config HPM_FEMC
	bool "FEMC"
	select HPM_FEMC_DRV
	default n

config HPM_SDP
	bool "SDP"
	select HPM_SDP_DRV
	default y

config HPM_LCDC
	bool "LCDC"
	select HPM_LCDC_DRV
	default n

config HPM_I2C0
	bool "I2C0"
	select HPM_I2C_DRV
	default n

config HPM_I2C1
	bool "I2C1"
	select HPM_I2C_DRV
	default n

config HPM_UART0
	bool "UART0"
	select HPM_UART_DRV
	select ARCH_HAVE_UART0
	select UART0_SERIALDRIVER
	select ARCH_HAVE_SERIAL_TERMIOS
	default y

config HPM_DMA_DRV
	bool
	default n

config HPM_SPI_DRV
	bool
	default n

config HPM_DMA
	bool "DMA"
	select ARCH_DMA
	select HPM_DMA_DRV
	default n

config HPM6750_SPI2
	bool "SPI2"
	default n
	select HPM_SPI_DRV
	
config HPM6750_SPI2_DMA
	bool "SPI2_DMA"
	default n
	select ARCH_DMA
	select HPM_DMA_DRV

config HPM_COMPONENTS_DMA_MANAGER
	bool "DMA_MANAGER"
	default n

config HPM_COMPONENTS_SPI
	bool "COMPONENTS_SPI"
	default n

endmenu
```

## boards/risc-v/hpmicro/hpm6300evk-sdk/Kconfig
```kconfig
#
# For a description of the syntax of this configuration file,
# see misc/tools/kconfig-language.txt.
#

if ARCH_BOARD_HPM6300EVK_SDK

config SYSTEM_HEAPSIZE
	int "system heap size"
	default 16384

config HAVE_LEDS
	bool "Have user leds"
	default n
	select ARCH_HAVE_LEDS

config INCLUDE_BOOTHEADER
	bool
	default y

endif
```
